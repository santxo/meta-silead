## conf/distro/include/tdx-base.inc
```bitbake
require conf/distro/poky.conf
require conf/distro/include/arm-defaults.inc

DISTRO = "tdx-base"
DISTRO_NAME = "Toradex Distro Base"

TDX_BUILDNBR ?= "0"
TDX_PURPOSE ?= "Testing"

def get_tdx_prerelease(purpose, datetime):
    if purpose == "Testing":
        return '-devel-%s' % (datetime)
    elif purpose == "Nightly":
        return '-devel-%s' % (datetime[:8])
    elif purpose == "Monthly":
        return '-devel-%s' % (datetime[:6])
    elif purpose == "Release":
        return ''
    else:
        return '-devel-%s' % (datetime)

TDX_BUILD ?= "+build.${TDX_BUILDNBR}"
TDX_MATRIX_BUILD_TIME ?= "${DATETIME}"
TDX_MATRIX_BUILD_TIME[vardepsexclude] = "DATETIME"
TDX_PRERELEASE ?= "${@get_tdx_prerelease(d.getVar('TDX_PURPOSE'), d.getVar('TDX_MATRIX_BUILD_TIME'))}"
TDX_RELEASE ?= "0.0.0"

# Toradex Version number without date for U-Boot/Kernel and other Toradex
# specific software artifacts.
TDX_VERSION ?= "${TDX_RELEASE}${@'' if d.getVar('TDX_PURPOSE') == 'Release' else '-devel'}"

# Complete image version with date and build number
DISTRO_VERSION = "${TDX_RELEASE}${TDX_PRERELEASE}${TDX_BUILD}"

SDK_VENDOR = "-tdxsdk"
SDK_NAME_PREFIX = "${DISTRO}"

MAINTAINER = "Toradex <yocto-patches@toradex.com>"

TARGET_VENDOR = "-tdx"

DISTROOVERRIDES = "tdx"

# create etc/build in the rootfs
INHERIT += "image-buildinfo"

# Log information on images and packages
INHERIT += "buildhistory"
BUILDHISTORY_COMMIT = "1"

# Use bluez5 as default.
DISTRO_FEATURES_append = " bluez5"

IMAGE_LINGUAS ?= "en-us"

# TODO: review default distro features
DISTRO_FEATURES_append = " pam systemd"
DISTRO_FEATURES_remove = "sysvinit"
VIRTUAL-RUNTIME_init_manager = "systemd"
PACKAGECONFIG_append_pn-qemu-native = " libusb"

# Use i.MX Gstreamer Version (for PXP DMA-ENGINE Driver)
PREFERRED_VERSION_gstreamer1.0_imx = "1.16.imx"
PREFERRED_VERSION_gstreamer1.0-plugins-base_imx = "1.16.imx"
PREFERRED_VERSION_gstreamer1.0-plugins-good_imx = "1.16.imx"
PREFERRED_VERSION_gstreamer1.0-plugins-bad_imx = "1.16.imx"

# these 1.14.imx variants have their COMPATIBLE set so that they don't build
# for use-mainline-bsp
PREFERRED_VERSION_gstreamer1.0_use-mainline-bsp = "1.16%"
PREFERRED_VERSION_gstreamer1.0-plugins-base_use-mainline-bsp = "1.16%"
PREFERRED_VERSION_gstreamer1.0-plugins-good_use-mainline-bsp = "1.16%"
PREFERRED_VERSION_gstreamer1.0-plugins-bad_use-mainline-bsp = "1.16%"
```

## conf/distro/tdx-x11-rt.conf
```bitbake
# Toradex Distro with X11 without wayland.
# Using the downstream kernel flavour with rt-patch applied.

require conf/distro/tdx-x11.conf

DISTRO = "tdx-x11-rt"
DISTRO_NAME = "TDX X11 RT"
DISTROOVERRIDES .= ":preempt-rt"
DISTRO_FLAVOUR = " (PREEMPT_RT)"
```

## conf/distro/tdx-x11.conf
```bitbake
# Toradex Distro with X11 without wayland.
# Using the downstream kernel flavour.

require conf/distro/include/tdx-base.inc

DISTRO = "tdx-x11"
DISTRO_NAME = "TDX X11"
DISTRO_FLAVOUR = ""

# Remove conflicting backends.
DISTRO_FEATURES_remove = "wayland "

# we use graphics, so set opengl
DISTRO_FEATURES_append = " opengl"

# These are X11 specific
DISTRO_FEATURES_append = " x11"

# lxqt requires this
DISTRO_FEATURES_append = " polkit"
```

## conf/distro/tdx-xwayland-rt.conf
```bitbake
# Toradex Distro for Wayland with XWayland.
# Using the downstream kernel flavour with rt-patch applied.

require conf/distro/tdx-xwayland.conf

DISTRO = "tdx-xwayland-rt"
DISTRO_NAME = "TDX Wayland with XWayland RT"
DISTROOVERRIDES .= ":preempt-rt"
DISTRO_FLAVOUR = " (PREEMPT_RT)"
```

## conf/distro/tdx-xwayland.conf
```bitbake
# Toradex Distro for Wayland with XWayland.
# Using the downstream kernel flavour.

require conf/distro/include/tdx-base.inc

DISTRO = "tdx-xwayland"
DISTRO_NAME = "TDX Wayland with XWayland"
DISTRO_FLAVOUR = ""

# we use graphics, so set opengl
DISTRO_FEATURES_append = " opengl"

DISTRO_FEATURES_append = " wayland x11"

# lxqt requires this
DISTRO_FEATURES_append = " polkit"
```

## conf/layer.conf
```bitbake
# We have a conf and classes directory, add to BBPATH
BBPATH .= ":${LAYERDIR}"

# We have a recipes-*directories, add to BBFILES
BBFILES += "${LAYERDIR}/recipes-*/*/*.bb \
            ${LAYERDIR}/recipes-*/*/*.bbappend"

BBFILE_COLLECTIONS += "silead"
BBFILE_PATTERN_silead = "^${LAYERDIR}/"
BBFILE_PRIORITY_silead = "6" 

LAYERSERIES_COMPAT_silead = "dunfell"
```

## meta-silead/conf/distro/include/arm-defaults.inc
```bitbake
# This function changes the default tune for machines which
# are based on armv7a or armv7ve to use common tune value, note
# that we enforce hard-float which is default on Linux microPlatform.
# If you have one of those machines which are armv7a or armv7ve but
# can't support hard-float, please change tune = 'armv7athf' to
# tune = 'armv7at' below but then this is for your own distro.

def at_least_one(elements, list):
    for i in list:
        if i in elements:
            return True
    return False

def arm_tune_handler(d):
    armv7athf_tune_features = ['armv7a', 'armv7ve', 'cortexa5', 'cortexa7', 'cortexa9', 'cortexa15']
    features = d.getVar('TUNE_FEATURES', True).split()
    if at_least_one(armv7athf_tune_features, features):
        tune = 'armv7athf'
        if 'bigendian' in features:
            tune += 'b'
        if 'vfpv3' in features:
            tune += '-vfpv3'
        if 'vfpv3d16' in features:
            tune += '-vfpv3d16'
        if 'neon' in features:
            tune += '-neon'
        if 'vfpv4' in features:
            tune += '-vfpv4'
    else:
        tune = d.getVar('DEFAULTTUNE', True)
    return tune

DEFAULTTUNE_tdx := "${@arm_tune_handler(d)}"
DEFAULTTUNE_torizon := "${@arm_tune_handler(d)}"

DISTRO_ARM_INSTRUCTION ?= "thumb"
DISTRO_ARM_INSTRUCTION_armv5 ?= "arm"
ARM_INSTRUCTION_SET_tdx ??= "${DISTRO_ARM_INSTRUCTION}"
```
